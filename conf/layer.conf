## conf/layer.conf
```bitbake
# https://gerrit.automotivelinux.org/gerrit/gitweb?p=AGL/meta-agl-devel.git;a=tree;f=meta-offline-voice-agent;hb=HEAD

# We have a conf and classes directory, add to BBPATH
BBPATH .= ":${LAYERDIR}"

# We have recipes-* directories, add to BBFILES
BBFILES += " \
        ${LAYERDIR}/recipes-*/*.bb \
        ${LAYERDIR}/recipes-*/*.bbappend \
        ${LAYERDIR}/recipes-*/*/*.bb \
        ${LAYERDIR}/recipes-*/*/*.bbappend \
"

BBFILE_COLLECTIONS += "voice"
BBFILE_PATTERN_voice = "^${LAYERDIR}/"
BBFILE_PRIORITY_voice = "19"

LAYERSERIES_COMPAT_voice = "dunfell"
```
